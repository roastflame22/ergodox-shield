## boards/shields/ergodox/Kconfig.defconfig
```kconfig
if SHIELD_ERGODOX_LEFT

config ZMK_KEYBOARD_NAME
    default "ergodox"

config ZMK_SPLIT_ROLE_CENTRAL
    default y

endif

if SHIELD_ERGODOX_LEFT || SHIELD_ERGODOX_RIGHT

config ZMK_SPLIT
    default y

endif
```
