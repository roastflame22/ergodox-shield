#include "ergodox.dtsi" // Notice that the main dtsi files are included in the overlay.

&kscan0 {
    col-gpios //                                   pin
        = <&pro_micro 2 GPIO_ACTIVE_HIGH> // col0  017
        , <&pro_micro 3 GPIO_ACTIVE_HIGH> // col1  020
        , <&pro_micro 4 GPIO_ACTIVE_HIGH> // col2  022
        , <&pro_micro 5 GPIO_ACTIVE_HIGH> // col3  024
        , <&pro_micro 6 GPIO_ACTIVE_HIGH> // col4  100
        , <&pro_micro 7 GPIO_ACTIVE_HIGH> // col5  011
        , <&pro_micro 8 GPIO_ACTIVE_HIGH> // col6  104
        , <&pro_micro 9 GPIO_ACTIVE_HIGH> // col7  106
        ;
};
